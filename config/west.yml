## config/west.yml
```yaml
manifest:
  remotes:
    - name: zmkfirmware
      url-base: https://github.com/zmkfirmware
    - name: kumamuk-git
      url-base: https://github.com/kumamuk-git
    # 変更点 1: あなたのGitHubアカウントをリモートとして追加
    - name: shotaroishiguro
      url-base: https://github.com/ShotaroIshiguro
  projects:
    - name: zmk
      remote: zmkfirmware
      revision: main
      import: app/west.yml
    - name: zmk-pmw3610-driver
      # 変更点 2: 参照先を kumamuk-git からあなたのリモートに変更
      remote: shotaroishiguro
      revision: main
  self:
    path: config
```
